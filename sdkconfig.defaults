## sdkconfig.defaults
```kconfig
# 嘉立创 ESP32-S3 开发板通用配置
CONFIG_IDF_TARGET="esp32s3"

# Flash 8MB（嘉立创 ESP32-S3 常见配置）
CONFIG_ESPTOOLPY_FLASHSIZE_8MB=y

# 自定义分区表：app 分区扩到 3MB（容纳天气预报功能）
CONFIG_PARTITION_TABLE_CUSTOM=y
CONFIG_PARTITION_TABLE_CUSTOM_FILENAME="partitions.csv"

# PSRAM（实战派 8MB Octal PSRAM，LCD 帧缓冲使用）
CONFIG_SPIRAM=y
CONFIG_SPIRAM_MODE_OCT=y
CONFIG_SPIRAM_SPEED_80M=y

# HTTPS 需要完整 CA 证书包（和风天气 API）
CONFIG_MBEDTLS_CERTIFICATE_BUNDLE=y
CONFIG_MBEDTLS_CERTIFICATE_BUNDLE_DEFAULT_FULL=y

# 主任务栈加大（HTTPS + JSON 解析）
CONFIG_ESP_MAIN_TASK_STACK_SIZE=8192

# FreeRTOS 时钟
CONFIG_FREERTOS_HZ=1000

# 看门狗放宽（首次 HTTPS 握手较慢）
CONFIG_ESP_TASK_WDT_TIMEOUT_S=30
```
